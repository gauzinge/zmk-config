/*
 * Copyright (c) 2020 The ZMK Contributors
 *
 * SPDX-License-Identifier: MIT
 */

#include <behaviors.dtsi>
#include <dt-bindings/zmk/bt.h>
#include <dt-bindings/zmk/keys.h>
#include <dt-bindings/zmk/mouse.h>
#define _BT_SEL_KEYS_                                                          \
  &bt BT_SEL 0 & bt BT_SEL 1 & bt BT_SEL 2 & bt BT_SEL 3 & bt BT_CLR

#include "zmk-helpers/helper.h"
#include "zmk-helpers/unicode-chars/german.dtsi"

#define DEF 0
#define COL 1
#define NAV 2
#define NUM 3
#define SYM 4
#define LAN 5
#define SYS 6

#define MYALL 0 1 2 3 4 5 6


// OSX
#define PREV_DSK &kp LC(LEFT)
#define NEXT_DSK &kp LC(RIGHT)
#define CP LG(C)
#define CT LG(X)
#define PST LG(V)
#define UDO LG(Z)
#define RDO LS(LG(Z))

// WIN
#define WCP LC(C)
#define WCT LC(X)
#define WPST LC(V)
#define WUDO LC(Z)
#define WRDO LS(LC(Z))
#define WNEW_TAB LC(T)


/*#include "combos.dtsi"  // requires layer aliases*/
/*#include "extra_keys.h"*/

/*layers and shortcuts*/
#define XXX &none
#define ___ &trans

/* Global settings */

#define QUICK_TAP_MS 175

&sk {                           // sticky-key config
  release-after-ms = <900>; // release after 0.6s
  quick-release;              // no double capitalization when rolling keys
};

&sl {                 // sticky-layer config
  ignore-modifiers; // allow chording sticky mods & layers
};

&lt { // layer-tap config
  flavor = "balanced";
  tapping-term-ms = <200>;
  quick-tap-ms = <QUICK_TAP_MS>;
};

&mt { // layer-tap config
  flavor = "balanced";
  tapping-term-ms = <200>;
  quick-tap-ms = <QUICK_TAP_MS>;
};
/*custom behaviors*/

#define KEYS_L                                                                 \
  LT0 LT1 LT2 LT3 LT4 LT5 LM0 LM1 LM2 LM3 LM4 LM5 LB0 LB1 LB2 LB3 LB4          \
      LB5 // left hand
#define KEYS_R                                                                 \
  RT0 RT1 RT2 RT3 RT4 RT5 RM0 RM1 RM2 RM3 RM4 RM5 RB0 RB1 RB2 RB3 RB4          \
      RM5 // right hand
#ifndef LH4
#define THUMBS LH2 LH1 LH0 RH0 RH1 RH2 // thumbs
#else
#define THUMBS LH4 LH3 LH2 LH1 LH0 RH0 RH1 RH2 RH3 RH4 // thumbs
#endif

/* left-hand HRMs */
ZMK_BEHAVIOR(hml, hold_tap,
             flavor = "balanced";
             tapping-term-ms = <250>;
             quick-tap-ms = <QUICK_TAP_MS>; // repeat on tap-into-hold
             require-prior-idle-ms = <140>; bindings = <&kp>, <&kp>;
             hold-trigger-key-positions = <KEYS_R THUMBS>;
             hold-trigger-on-release; // delay positional check until key-release
)
/* right-hand HRMs */
ZMK_BEHAVIOR(hmr, hold_tap,
             flavor = "balanced";
             tapping-term-ms = <249>;
             quick-tap-ms = <QUICK_TAP_MS>; // repeat on tap-into-hold
             require-prior-idle-ms = <140>; bindings = <&kp>, <&kp>;
             hold-trigger-key-positions = <KEYS_L THUMBS>;
             hold-trigger-on-release; // delay positional check until key-release
)

ZMK_BEHAVIOR(hms, hold_tap,
             flavor = "balanced";
             tapping-term-ms = <250>;
             quick-tap-ms = <QUICK_TAP_MS>; // repeat on tap-into-hold
             require-prior-idle-ms = <140>;
             bindings = <&kp>, <&col_semi_inner>;
             hold-trigger-key-positions = <KEYS_L THUMBS>;
             hold-trigger-on-release; // delay positional check until key-release
)

#include "extra_keys.h"

// normal: tilde, shift: grave
ZMK_BEHAVIOR(col_semi_inner, mod_morph, bindings = <&kp COLON>, <&kp SEMI>;
             mods = <(MOD_LSFT | MOD_RSFT)>;)

// tap: backspace | shift + tap: delete | hold: num layer
ZMK_BEHAVIOR(bs_del_num, mod_morph, bindings = <&lt NUM BSPC>, <&kp DEL>;
             mods = <(MOD_LSFT | MOD_RSFT)>;)

// tap: backspace | shift + tap: delete
ZMK_BEHAVIOR(bs_del, mod_morph, bindings = <&kp BSPC>, <&kp DEL>;
             mods = <(MOD_LSFT | MOD_RSFT)>;)

/* Caps-word, num-word */
// tap: sticky-shift | shift + tap/ double-tap: caps-word | hold: shift
ZMK_BEHAVIOR(smart_shft, mod_morph, bindings = <&sk LSHFT>, <&caps_word>;
             mods = <(MOD_LSFT)>;)
&caps_word { // mods deactivate caps-word, requires PR #1451
  /delete-property/ ignore-modifiers;
  continue-list = <A B C D E F G H I J K L M N O P Q R S T U V W X Y Z UNDERSCORE MINUS>;
};

// Alt+Tab swapper, requires PR #1366
ZMK_TRI_STATE(swapper, bindings = <&kt LALT>, <&kp TAB>, <&kt LALT>;
              ignored-key-positions = <LT2>;)
//ZMK_TRI_STATE(swapper_bk, bindings = <&kt LS(LALT)>, <&kp TAB>, <&kt LS(LALT)>;
//              ignored-key-positions = <LT2>;)

ZMK_TRI_STATE(tab, bindings = <&kt LCTRL>, <&kp TAB>, <&kt LCTRL>;
              ignored-key-positions = <LT2>;)
//ZMK_TRI_STATE(tab_bk, bindings = <&kt LS(LCTRL)>, <&kp TAB>, <&kt LS(LCTRL)>;
//              ignored-key-positions = <LT2>;)

// normal: tilde, shift: grave
ZMK_BEHAVIOR(tilde_grave, mod_morph, bindings = <&kp TILDE>, <&kp GRAVE>;
             mods = <(MOD_LSFT | MOD_RSFT)>;)

ZMK_BEHAVIOR(copy_cut, tap_dance, tapping-term-ms = <200>;
             bindings = <&kp CP>, <&kp CT>;)

ZMK_BEHAVIOR(udo_rdo, tap_dance, tapping-term-ms = <200>;
             bindings = <&kp UDO>, <&kp RDO>;)

ZMK_BEHAVIOR(wcopy_cut, tap_dance, tapping-term-ms = <200>;
             bindings = <&kp WCP>, <&kp WCT>;)

ZMK_BEHAVIOR(wudo_rdo, tap_dance, tapping-term-ms = <200>;
             bindings = <&kp WUDO>, <&kp WRDO>;)

#undef COMBO_TERM
#define COMBO_TERM 40 // timeout of 40ms (default is 30ms if omitted)
ZMK_COMBO(combo_copy, &kp LG(C), LB3 LB4, MYALL) // Ctrl + C, active on all layers
ZMK_COMBO(combo_paste, &kp LG(V), LB1 LB2,
          MYALL)                                 // Ctrl + V, active on all layers
ZMK_COMBO(combo_tab, &kp TAB, LT3 LT4, MYALL)    // esc
ZMK_COMBO(combo_esc, &kp ESC, RM1 RM2, MYALL)    // esc
ZMK_COMBO(combo_bsp, &kp BSPC, RT3 RT4, MYALL)   // backspace
ZMK_COMBO(combo_quotes, &kp SQT, RM3 RM4, DEF) // quotes, only on default
ZMK_COMBO(combo_sym_minus, &kp MINUS, LT1 RT1, MYALL) // minus, all layers
ZMK_COMBO(combo_sym_under, &kp UNDER, LB1 RB1, MYALL) // under, all layers
ZMK_COMBO(combo_capsword, &caps_word, LB5 RB5,
          MYALL) // capsword, both shifts, all layers
ZMK_COMBO(combo_capsword, &caps_word, LM1 RM1,
          MYALL) // capsword, both hrm shifts, all layers
ZMK_COMBO(combo_volup, &kp C_VOL_UP, RT4 RT5, MYALL)
ZMK_COMBO(combo_voldn, &kp C_VOL_DN, LT5 LT4, MYALL)
ZMK_COMBO(combo_middlclk, &mkp MCLK, LM3 LM4, NAV)

/* Keymap */

ZMK_CONDITIONAL_LAYER(system, LAN NUM, SYS)  // NAV + SYM --> SYS

ZMK_LAYER(default,
     // ╭─────────────┬─────────────┬─────────────┬─────────────┬─────────────┬─────────────╮   ╭─────────────┬─────────────┬─────────────┬─────────────┬─────────────┬─────────────╮
            &kp ESC        &kp Q         &kp W         &kp E         &kp R        &kp T              &kp Y         &kp U         &kp I         &kp O         &kp P       &bs_del
     // ├─────────────┼─────────────┼─────────────┬─────────────┼─────────────┼─────────────┤   ├─────────────┬─────────────┼─────────────┼─────────────┼─────────────┼─────────────┤
         &mt LCTRL TAB     &kp A         &kp S         &kp D     &hml LSHFT F     &kp G              &kp H      &hmr RSHFT J     &kp K         &kp L        &kp SEMI     &lt LAN SQT
     // ├─────────────┼─────────────┼─────────────┬─────────────┼─────────────┼─────────────┤   ├─────────────┬─────────────┼─────────────┼─────────────┼─────────────┼─────────────┤
          &smart_shft      &kp Z         &kp X         &kp C         &kp V         &kp B              &kp N        &kp M      &kp COMMA      &kp DOT        &kp FSLH     &smart_shft
     // ╰─────────────┼─────────────┼─────────────┬─────────────┼───────────────────────────┤   ├───────────────────────────┼─────────────┼─────────────┼─────────────┼─────────────┤
           X_LOD           X_LID     &mt LCTRL LPAR  &lt NAV TAB       &mt LALT RET                   &lt SYM SPACE         &bs_del_num  &mt LALT RPAR      X_RID        X_ROD
     // ╰─────────────┴────────────╯╰─────────────┴─────────────┴───────────────────────────╯   ╰───────────────────────────┴─────────────┴─────────────╯╰────────────┴─────────────╯
)

ZMK_LAYER(colemak,
     //╭───────────╮ ╭─────────────┬─────────────┬─────────────┬─────────────┬─────────────╮   ╭─────────────┬─────────────┬─────────────┬─────────────┬─────────────╮ ╭───────────╮
      &mt LS(LGUI) ESC    &kp Q         &kp W         &kp F         &kp P        &kp G              &kp J         &kp L         &kp U         &kp Y       &kp SEMI        &bs_del     
     //├───────────┤ ├─────────────┼─────────────┬─────────────┼─────────────┼─────────────┤   ├─────────────┬─────────────┼─────────────┼─────────────┼─────────────┤ ├───────────┤
      &mt LS(LALT) TAB &hml LCTRL A   &hml LALT R    &kp S        &hml LSHFT T   &kp D              &kp H      &hmr RSHFT N     &kp E      &hmr LALT I &hmr LCTRL O     &lt LAN SQT
     //├───────────┤ ├─────────────┼─────────────┬─────────────┼─────────────┼─────────────┤   ├─────────────┬─────────────┼─────────────┼─────────────┼─────────────┤ ├───────────┤
        &smart_shft       &kp Z         &kp X         &kp C         &kp V        &kp B              &kp K         &kp M       &kp COMMA      &kp DOT       &kp FSLH     &smart_shft     
     //╰───────────┤ ╰─────────────┼─────────────┬─────────────┼───────────────────────────┤   ├───────────────────────────┼─────────────┼─────────────┼─────────────┤ ╰───────────┤
           X_LOD         X_LID      &mt LGUI LPAR  &lt NAV TAB        &mt LCTRL RET                   &lt SYM SPACE         &bs_del_num  &mt LALT RPAR   X_RID             X_ROD   
     //╰───────────╯ ╰────────────╯╰─────────────┴─────────────┴───────────────────────────╯   ╰───────────────────────────┴─────────────┴─────────────╯╰────────────╯ ╰───────────╯
)



ZMK_LAYER(nav,
     //╭───────────╮ ╭─────────────┬─────────────┬─────────────┬─────────────┬─────────────╮   ╭─────────────┬─────────────┬─────────────┬─────────────┬─────────────╮ ╭───────────╮
             ___       &kp LA(N1)      &kp LA(N2)  &mkp MCLK     &kp LA(N4)    &kp WNEW_TAB       &wcopy_cut    &kp LC(U)          XXX           XXX        &kp WPST        ___     
     //├───────────┤ ├─────────────┼─────────────┬─────────────┼─────────────┼─────────────┤   ├─────────────┬─────────────┼─────────────┼─────────────┼─────────────┤ ├───────────┤
          &swapper      &kp LC(A)     &kp RALT    &mkp RCLK     &mkp LCLK     &kp HOME          &kp LEFT     &kp DOWN       &kp UP        &kp RIGHT      &kp END         XXX     
     //├───────────┤ ├─────────────┼─────────────┬─────────────┼─────────────┼─────────────┤   ├─────────────┬─────────────┼─────────────┼─────────────┼─────────────┤ ├───────────┤
      &kp LS(LA(N4))   &wudo_rdo       &kp WCT      &kp WCP        &kp WPST       XXX               &kp V         XXX      &kp LA(COMMA)   &kp LA(DOT)      XXX            ___     
     //╰───────────┤ ╰─────────────┼─────────────┬─────────────┼───────────────────────────┤   ├───────────────────────────┼─────────────┼─────────────┼─────────────┤ ╰───────────┤
            X_LOW        X_LIW            XXX            XXX               XXX                       &mt LCTRL SPACE              XXX        &kp LALT        X_RIW          X_ROW    
     //╰───────────╯ ╰────────────╯╰─────────────┴─────────────┴───────────────────────────╯   ╰───────────────────────────┴─────────────┴─────────────╯╰────────────╯ ╰───────────╯
)

ZMK_LAYER(num,
     //╭───────────╮ ╭─────────────┬─────────────┬─────────────┬─────────────┬─────────────╮   ╭─────────────┬─────────────┬─────────────┬─────────────┬─────────────╮ ╭───────────╮
             XXX        &kp MINUS      &kp N1        &kp N2         &kp N3       &kp PLUS             XXX           XXX          XXX            XXX          XXX             XXX     
     //├───────────┤ ├─────────────┼─────────────┬─────────────┼─────────────┼─────────────┤   ├─────────────┬─────────────┼─────────────┼─────────────┼─────────────┤ ├───────────┤
             XXX        &kp FSLH       &kp N4        &kp N5         &kp N6       &kp STAR            XXX        &kp LSHFT     &kp LGUI      &kp LALT      &kp LCTRL        &mo LAN     
     //├───────────┤ ├─────────────┼─────────────┬─────────────┼─────────────┼─────────────┤   ├─────────────┬─────────────┼─────────────┼─────────────┼─────────────┤ ├───────────┤
             ___        &kp DOT        &kp N7        &kp N8         &kp N9       &kp EQUAL            XXX          XXX           XXX            XXX          XXX             ___     
     //╰───────────┤ ╰─────────────┼─────────────┬─────────────┼───────────────────────────┤   ├───────────────────────────┼─────────────┼─────────────┼─────────────┤ ╰───────────┤
            X_LO         X_LI       &mt LGUI LPAR    &kp N0           &mt LCTRL RPAR                         XXX                 XXX            XXX          X_RI            X_RO    
     //╰───────────╯ ╰────────────╯╰─────────────┴─────────────┴───────────────────────────╯   ╰───────────────────────────┴─────────────┴─────────────╯╰────────────╯ ╰───────────╯
)

ZMK_LAYER(sym,
     //╭───────────╮ ╭─────────────┬─────────────┬─────────────┬─────────────┬─────────────╮   ╭─────────────┬─────────────┬─────────────┬─────────────┬──────────────╮ ╭───────────╮
             XXX        &tilde_grave   &kp EXCL      &kp AT         &kp HASH      &kp FSLH            XXX           XXX           XXX           XXX           XXX            XXX     
     //├───────────┤ ├─────────────┼─────────────┬─────────────┼─────────────┼─────────────┤   ├─────────────┬─────────────┼─────────────┼─────────────┼──────────────┤ ├───────────┤
             XXX        &kp PIPE      &kp CARET     &kp PRCNT      &kp DLLR      &kp BSLH            XXX         &kp LSHFT     &kp LGUI       &kp LALT     &kp LCTRL         XXX     
     //├───────────┤ ├─────────────┼─────────────┬─────────────┼─────────────┼─────────────┤   ├─────────────┬─────────────┼─────────────┼─────────────┼──────────────┤ ├───────────┤
             ___        &kp UNDER     &kp AMPS      &kp STAR       &kp LPAR      &kp RPAR            XXX            XXX           XXX          XXX           XXX             ___     
     //╰───────────┤ ╰─────────────┼─────────────┬─────────────┼───────────────────────────┤   ├───────────────────────────┼─────────────┼─────────────┼──────────────┤ ╰───────────┤
            X_LO          X_LI        &kp LBKT      &kp RBKT             &kp LBRC                          XXX                   XXX           XXX           X_RI            X_RO    
     //╰───────────╯ ╰────────────╯╰─────────────┴─────────────┴───────────────────────────╯   ╰───────────────────────────┴─────────────┴─────────────╯╰─────────────╯ ╰───────────╯
)

ZMK_LAYER(lan,
     //╭───────────╮ ╭─────────────┬─────────────┬─────────────┬─────────────┬────────────╮   ╭─────────────┬──────────────┬─────────────┬─────────────┬─────────────╮ ╭───────────╮
         &kp GRAVE        XXX            XXX         &kp RA(E)       XXX           XXX              XXX          &kp RA(Y)       XXX         &kp RA(P)       XXX            ___    
     //├───────────┤ ├─────────────┼─────────────┬─────────────┼─────────────┼─────────────┤   ├─────────────┬─────────────┼─────────────┼─────────────┼─────────────┤ ├───────────┤
             XXX       &kp RA(Q)   &kp RA(S)        XXX           XXX           XXX               XXX           XXX           XXX             XXX           XXX             XXX     
     //├───────────┤ ├─────────────┼─────────────┬─────────────┼─────────────┼─────────────┤   ├─────────────┬─────────────┼─────────────┼─────────────┼─────────────┤ ├───────────┤
             ___          XXX            XXX          XXX           XXX           XXX               XXX           XXX         &to DEF        &to COL         XXX           ___     
     //╰───────────┤ ╰─────────────┼─────────────┬─────────────┼───────────────────────────┤   ├───────────────────────────┼─────────────┼─────────────┼─────────────┤ ╰───────────┤
            X_LO          X_LI           XXX          XXX                 XXX                              XXX                &mo NUM         XXX           X_RI            X_RO    
     //╰───────────╯ ╰────────────╯╰─────────────┴─────────────┴───────────────────────────╯   ╰───────────────────────────┴─────────────┴─────────────╯╰────────────╯ ╰───────────╯
)

ZMK_LAYER(sys,
     //╭───────────╮ ╭─────────────┬─────────────┬─────────────┬─────────────┬─────────────╮   ╭─────────────┬─────────────┬─────────────┬─────────────┬─────────────╮ ╭───────────╮
          &kp F1         &kp F2        &kp F3       &kp F4        &kp F5       &kp F6              &kp F7        &kp F8       &kp F9       &kp F10        &kp F11         &kp F12     
     //├───────────┤ ├─────────────┼─────────────┬─────────────┼─────────────┼─────────────┤   ├─────────────┬─────────────┼─────────────┼─────────────┼─────────────┤ ├───────────┤
             XXX       &sys_reset    &bootloader      XXX           XXX          XXX           &kp LC(LS(M))  &kp C_VOL_UP      XXX           XXX        &sys_reset         XXX     
     //├───────────┤ ├─────────────┼─────────────┬─────────────┼─────────────┼─────────────┤   ├─────────────┬─────────────┼─────────────┼─────────────┼─────────────┤ ├───────────┤
             ___      &bt BT_SEL 0  &bt BT_SEL 1  &bt BT_SEL 2   &bt BT_CLR  &studio_unlock       &kp C_MUTE  &kp C_VOL_DN      XXX           XXX           XXX             ___     
     //╰───────────┤ ╰─────────────┼─────────────┬─────────────┼───────────────────────────┤   ├───────────────────────────┼─────────────┼─────────────┼─────────────┤ ╰───────────┤
            X_LO          X_LI          XXX            XXX                 XXX                              XXX                 XXX           XXX           X_RI            X_RO    
     //╰───────────╯ ╰────────────╯╰─────────────┴─────────────┴───────────────────────────╯   ╰───────────────────────────┴─────────────┴─────────────╯╰────────────╯ ╰───────────╯
)
