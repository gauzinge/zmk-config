## config/west.yml
```yaml
manifest:
  remotes:
    - name: zmkfirmware
      url-base: https://github.com/zmkfirmware
    - name: urob
      url-base: https://github.com/urob
    - name: petejohanson
      url-base: https://github.com/petejohanson
    - name: dhruvinsh
      url-base: https://github.com/dhruvinsh
    # - name: englmaxi
      # url-base: https://gihub.com/englmaxi
    # - name: badjeff
      # url-base: https://github.com/badjeff
    - name: ergohaven
      url-base: https://github.com/ergohaven
  projects:
    - name: zmk
      #remote: urob
      remote: zmkfirmware
      revision: v0.3
      import: app/west.yml
    - name: zmk-helpers
      remote: urob
      revision: v0.3
    - name: blank-slate-zmk-module
      remote: petejohanson
      #revision: soft-off-from-main
      revision: v0.3
      # Add this project entry:
    - name: zmk-tri-state
      remote: dhruvinsh
      revision: main
    # - name: zmk-hid-trackball-interface
      # remote: englmaxi
      # revision: main
    - name: zmk-pmw3610-driver
      remote: ergohaven
      revision: eh
    - name: ergohaven-zmk
      remote: ergohaven
      revision: main
      import: config/west.yml
  self:
    path: config
```
